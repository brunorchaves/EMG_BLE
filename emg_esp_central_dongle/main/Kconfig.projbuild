## emg_esp_central_dongle/main/Kconfig.projbuild
```kconfig
menu "Wifi Provisioning Configuration"

    config APPLICATION_PROV_MGR_MAX_RETRY_CNT
        int
        default 5
        prompt "Max retries before reseting provisioning state machine"
        help
            Set the Maximum retry to avoid reconnecting to an inexistent AP or if credentials
            are misconfigured. Provisioned credentials are erased and internal state machine
            is reset after this threshold is reached.

endmenu
```
